## conf/machine/maaxboard-nano-ddr4-1g-sdcard.conf
```bitbake
#@TYPE: Machine
#@NAME: Embest MaaxBoard Nano
#@SOC: i.MX8MN
#@DESCRIPTION: Machine configuration for Embest MaaxBoard Nano, DDR4, SDCard
#@MAINTAINER: Paul Niu <ahnniu@gmail.com>

include conf/machine/include/maaxboard-nano-base.inc
```

## conf/machine/maaxboard-nano.conf
```bitbake
#@TYPE: Machine
#@NAME: Avnet MaaxBoard-Nano
#@SOC: i.MX8M Nano
#@DESCRIPTION: Machine configuration for Avnet MaaxBoard-Nano 1G, DDR4, SDCard
#@MAINTAINER: Leevi Li <leevi.li@avnet.com>
#@REFERENCE: meta-freescale/conf/machine/imx8mn-ddr4-evk.conf

MACHINEOVERRIDES =. "mx8:mx8m:mx8mn:"
MACHINEOVERRIDES =. "maaxboardbase:maaxboardnano:"

require conf/machine/include/imx-base.inc
require conf/machine/include/arm/armv8a/tune-cortexa53.inc

MACHINE_FEATURES += " wifi bluetooth bcm43455"

# Set DDR FIRMWARE, Refer to: 
# meta-imx/meta-bsp/recipes-bsp/imx-mkimage/imx-boot_1.0.bb
# meta-imx/meta-bsp/recipes-bsp/firmware-imx/firmware-imx-8_8.18.bb
DDR_FIRMWARE_NAME = " ddr4_imem_1d*.bin ddr4_dmem_1d*.bin ddr4_imem_2d*.bin ddr4_dmem_2d*.bin "

# Set linux DTB
KERNEL_DEVICETREE = "freescale/maaxboard-nano.dtb"
KERNEL_IMAGETYPE = "Image"

# Set u-boot DTB 
UBOOT_DTB_NAME = "maaxboard-nano.dtb"
LOADADDR = ""
UBOOT_SUFFIX = "bin"
UBOOT_MAKE_TARGET = ""
SPL_BINARY = "spl/u-boot-spl.bin"
UBOOT_CONFIG ??= "sd"
UBOOT_CONFIG[sd] = "maaxboard-nano_defconfig,sdcard"
SERIAL_CONSOLES = "115200;ttymxc1"

# Set ATF platform name
ATF_PLATFORM = "imx8mn"

# Set imx-mkimage boot target
IMXBOOT_TARGETS = "flash_ddr4_evk"
IMX_BOOT_SOC_TARGET = "iMX8MN"
IMX_BOOT_SEEK = "32"
OPTEE_BIN_EXT = "8mn"

SOC_DEFAULT_IMAGE_FSTYPES:append = " wic"

# Remove unused QT example program
#CORE_IMAGE_EXTRA_INSTALL:remove += " qtbase-ptest qtbase-examples"

# Boot partition size [in KiB] for kernel and other data
# More refer to: meta-freescale/classes/image_types_fsl.bbclass
BOOT_SPACE = "65536"

# Add uEnv.txt file to FAT partition
WKS_FILE_DEPENDS:append = " uenv"
IMAGE_BOOT_FILES += "uEnv.txt"
IMAGE_BOOT_FILES += "readme.txt"
IMAGE_BOOT_FILES += "overlays/*;overlays/"

# /etc/hostname
hostname:pn-base-files = "maaxboardnano"
```

## conf/machine/maaxboard-osm93.conf
```bitbake
#@TYPE: Machine
#@NAME: Avnet MaaxBoard OSM93
#@SOC: i.MX93
#@DESCRIPTION: Machine configuration for Avnet MaaxBoard OSM93 with LPDDR4
#@MAINTAINER: Wenxue Guo <wenxue.guo@avnet.com>
#@REFERENCE: meta-freescale/conf/machine/imx93-11x11-lpddr4x-evk.conf

MACHINEOVERRIDES =. "mx93:"
MACHINEOVERRIDES =. "maaxboardbase:maaxboardosm93:"

require conf/machine/include/imx-base.inc
require conf/machine/include/arm/armv8-2a/tune-cortexa55.inc

MACHINE_FEATURES += " wifi bluetooth"

# Set DDR FIRMWARE
DDR_FIRMWARE_NAME = " \ 
    lpddr4_dmem_1d_v202201.bin \
    lpddr4_dmem_2d_v202201.bin \
    lpddr4_imem_1d_v202201.bin \
    lpddr4_imem_2d_v202201.bin \
"

# Set linux DTB
KERNEL_DEVICETREE = "freescale/${MACHINE}.dtb"

# Set U-boot config
UBOOT_DTB_NAME = "${MACHINE}.dtb"
LOADADDR = ""
UBOOT_SUFFIX = "bin"
UBOOT_MAKE_TARGET = ""
SPL_BINARY = "spl/u-boot-spl.bin"
UBOOT_CONFIG ??= "sd"
UBOOT_CONFIG[sd]   = "${MACHINE}_defconfig,sdcard"
SERIAL_CONSOLES = "115200;ttyLP0"

# Set ATF platform name
ATF_PLATFORM = "imx93"

# Set imx-mkimage boot target
IMXBOOT_TARGETS = "flash_singleboot_m33"
IMX_BOOT_SOC_TARGET = "iMX9"
IMX_BOOT_SEEK = "32"

# Add additional firmware
SOC_DEFAULT_IMAGE_FSTYPES:append = " wic"

# Add uEnv.txt file to FAT partition
WKS_FILE_DEPENDS:append = " uenv"
IMAGE_BOOT_FILES += "uEnv.txt"
IMAGE_BOOT_FILES += "readme.txt"
IMAGE_BOOT_FILES += "overlays/*;overlays/"

# /etc/hostname
hostname:pn-base-files = "maaxboardosm93"
```

## conf/machine/maaxboard.conf
```bitbake
#@TYPE: Machine
#@NAME: Avnet MaaxBoard
#@SOC: i.MX8MQ
#@DESCRIPTION: Machine configuration for Avnet MaaxBoard 2G, DDR4, SDCard
#@MAINTAINER: Wenxue Guo <wenxue.guo@avnet.com>
#@REFERENCE: meta-freescale/conf/machine/imx8mq-evk.conf

MACHINEOVERRIDES =. "mx8:mx8m:mx8mq:"
MACHINEOVERRIDES =. "maaxboardbase:maaxboard:"

require conf/machine/include/imx-base.inc
require conf/machine/include/arm/armv8a/tune-cortexa53.inc

MACHINE_FEATURES += " wifi bluetooth bcm43455"
MACHINE_SOCARCH_FILTER:append:mx8mq = " virtual/libopenvg virtual/libgles1 virtual/libgles2 virtual/egl virtual/mesa virtual/libgl virtual/libg2d"

# Set DDR FIRMWARE, Refer to: 
# meta-imx/meta-bsp/recipes-bsp/imx-mkimage/imx-boot_x.x.bb
# meta-imx/meta-bsp/recipes-bsp/firmware-imx/firmware-imx-x_x.xx.bb
DDR_FIRMWARE_NAME = " ddr4_imem_1d.bin ddr4_dmem_1d.bin ddr4_imem_2d.bin ddr4_dmem_2d.bin "

# Set linux DTB
KERNEL_DEVICETREE = "freescale/maaxboard.dtb"
KERNEL_IMAGETYPE = "Image"

# Set u-boot DTB 
UBOOT_DTB_NAME = "maaxboard.dtb"
LOADADDR = ""
UBOOT_SUFFIX = "bin"
UBOOT_MAKE_TARGET = ""
SPL_BINARY = "spl/u-boot-spl.bin"
UBOOT_CONFIG ??= "sd"
UBOOT_CONFIG[sd] = "maaxboard_defconfig,sdcard"
SERIAL_CONSOLES = "115200;ttymxc0"

# Set ATF platform name
ATF_PLATFORM = "imx8mq"

# Set imx-mkimage boot target
IMXBOOT_TARGETS = "flash_ddr4_val"
IMX_BOOT_SOC_TARGET = "iMX8M"
IMX_BOOT_SEEK = "33"
OPTEE_BIN_EXT = "8mq"

SOC_DEFAULT_IMAGE_FSTYPES:append = " wic"

# Remove unused QT example program
#CORE_IMAGE_EXTRA_INSTALL:remove += " qtbase-ptest qtbase-examples"

# Boot partition size [in KiB] for kernel and other data
# More refer to: meta-freescale/classes/image_types_fsl.bbclass
BOOT_SPACE = "65536"

# Add uEnv.txt file to FAT partition
WKS_FILE_DEPENDS:append = " uenv"
IMAGE_BOOT_FILES += "uEnv.txt"
IMAGE_BOOT_FILES += "readme.txt"
IMAGE_BOOT_FILES += "overlays/*;overlays/"

# /etc/hostname
hostname:pn-base-files = "maaxboard"
```
