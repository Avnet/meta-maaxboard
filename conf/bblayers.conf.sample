## conf/bblayers.conf.sample
```bitbake
# POKY_BBLAYERS_CONF_VERSION is increased each time build/conf/bblayers.conf
# changes incompatibly
POKY_BBLAYERS_CONF_VERSION = "2"

BBPATH = "${TOPDIR}"

# 
# imx-yocto-bsp
# ├── maaxboard
# │   └── build
# │       └── conf
# └── sources
#     ├── base
#     ├── meta-maaxboard
#     ├── meta-browser
#     ├── meta-freescale
#     ├── meta-freescale-3rdparty
#     ├── meta-freescale-distro
#     ├── meta-fsl-bsp-release
#     ├── meta-openembedded
#     ├── meta-qt5
#     └── poky

# The var BSPDIR is used by other recipes
# for example: meta-fsl-bsp-release/imx/meta-bsp/recipes-multimedia/gstreamer/gstreamer1.0_1.14.imx.bb
BSPDIR := "${@os.path.abspath(os.path.dirname(d.getVar('FILE', True)) + '/../../..')}"
BBFILES ?= ""

BBLAYERS ?= " \
  ${BSPDIR}/sources/poky/meta \
  ${BSPDIR}/sources/poky/meta-poky \
  \
  ${BSPDIR}/sources/meta-openembedded/meta-oe \
  ${BSPDIR}/sources/meta-openembedded/meta-multimedia \
  \
  ${BSPDIR}/sources/meta-freescale \
  ${BSPDIR}/sources/meta-freescale-3rdparty \
  ${BSPDIR}/sources/meta-freescale-distro \
"

BBLAYERS += " ${BSPDIR}/sources/meta-maaxboard "

BBLAYERS += " ${BSPDIR}/sources/meta-fsl-bsp-release/imx/meta-bsp "
BBLAYERS += " ${BSPDIR}/sources/meta-fsl-bsp-release/imx/meta-sdk "
BBLAYERS += " ${BSPDIR}/sources/meta-browser "
# BBLAYERS += " ${BSPDIR}/sources/meta-openembedded/meta-gnome "
BBLAYERS += " ${BSPDIR}/sources/meta-openembedded/meta-networking "
BBLAYERS += " ${BSPDIR}/sources/meta-openembedded/meta-python "
BBLAYERS += " ${BSPDIR}/sources/meta-openembedded/meta-filesystems "
BBLAYERS += " ${BSPDIR}/sources/meta-qt5 "
```

## conf/distro/fsl-imx-wayland-lite.conf
```bitbake
# i.MX DISTRO for Wayland without X11

# Origin from: meta-fsl-bsp-release/imx/meta-sdk/conf/distro/fsl-imx-wayland.conf
include conf/distro/include/fsl-imx-base.inc
include conf/distro/include/fsl-imx-preferred-env.inc

DISTRO = "fsl-imx-wayland-lite"

# Remove conflicting backends
DISTRO_FEATURES:remove = "directfb x11 "
DISTRO_FEATURES:append = " wayland pam systemd"
```

## conf/layer.conf
```bitbake
# We have a conf and classes directory, add to BBPATH
BBPATH .= ":${LAYERDIR}"

# We have recipes-* directories, add to BBFILES
BBFILES += "${LAYERDIR}/recipes-*/*/*.bb \
            ${LAYERDIR}/recipes-*/*/*.bbappend \
            ${LAYERDIR}/images/*.bb"

BBFILE_COLLECTIONS += "meta-maaxboard"
BBFILE_PATTERN_meta-maaxboard = "^${LAYERDIR}/"
# Priority should higher than NXP BSP (priority:8)
BBFILE_PRIORITY_meta-maaxboard = "9"
LAYERVERSION_meta-maaxboard = "1"
LAYERSERIES_COMPAT_meta-maaxboard = "honister"

MACHINE_EXTRA_RRECOMMENDS:append  = " uenv"

# Avnet Github Mirror
MAAXBOARD_GIT_HOST_MIRROR ?= "git://github.com/Avnet"
MAAXBOARD_GIT_PROTOCOL ?= "protocol=https"
MAAXBOARD_GIT_USER ?= ""
```

## conf/local.conf.sample
```bitbake
MACHINE ??= 'maaxboard'
DISTRO ?= 'fsl-imx-wayland-lite'
PACKAGE_CLASSES ?= 'package_deb'
EXTRA_IMAGE_FEATURES ?= "debug-tweaks tools-sdk tools-debug"
USER_CLASSES ?= "buildstats "
PATCHRESOLVE = "noop"
BB_DISKMON_DIRS ??= "\
    STOPTASKS,${TMPDIR},1G,100K \
    STOPTASKS,${DL_DIR},1G,100K \
    STOPTASKS,${SSTATE_DIR},1G,100K \
    STOPTASKS,/tmp,100M,100K \
    ABORT,${TMPDIR},100M,1K \
    ABORT,${DL_DIR},100M,1K \
    ABORT,${SSTATE_DIR},100M,1K \
    ABORT,/tmp,10M,1K"
PACKAGECONFIG:append:pn-qemu-system-native = " sdl"
CONF_VERSION = "2"

#DL_DIR ?= "${HOME}/oe-sources-langdale/"
ACCEPT_FSL_EULA = "1"

# Switch to Debian packaging and include package-management in the image
PACKAGE_CLASSES = "package_deb"
EXTRA_IMAGE_FEATURES += "package-management"

LICENSE_FLAGS_ACCEPTED += "commercial "
PACKAGECONFIG:pn-gstreamer1.0-plugins-ugly += "x264"

# uncomment these lines, you can set up your group repository where the code is stored
MAAXBOARD_GIT_HOST_MIRROR = "git://github.com/Avnet"
MAAXBOARD_GIT_PROTOCOL = "protocol=http"
#MAAXBOARD_GIT_USER = "user=your_name:your_password"
```

## conf/machine/include/maaxboard-8ulp-base.inc
```bitbake
# Avnet MaaxBoard 8ULP common settings

MACHINEOVERRIDES =. "mx8:mx8ulp:"
MACHINEOVERRIDES =. "maaxboardbase:maaxboard8ulp:"

require conf/machine/include/imx-base.inc
require conf/machine/include/arm/armv8a/tune-cortexa35.inc

DEFAULTTUNE:mx8ulp ?= "cortexa35-crypto"
MACHINEOVERRIDES_EXTENDER:mx8ulp = "imxdrm:imxgpu:imxgpu2d:imxgpu3d"
MACHINEOVERRIDES_EXTENDER_FILTER_OUT_use-mainline-bsp += " mx8ulp \
"
MACHINE_SOCARCH_SUFFIX = "-mx8ulp"
MACHINE_GSTREAMER_1_0_PLUGIN ?= "imx-gst1.0-plugin"
IMX_DEFAULT_KERNEL = "linux-imx"

IMX_DEFAULT_BSP = "nxp"

MACHINE_FEATURES += " wifi bluetooth"

KERNEL_DEVICETREE = " \
    freescale/${KERNEL_DEVICETREE_DTBNAME} \
"

IMX_DEFAULT_BOOTLOADER = "u-boot-imx"

LOADADDR = ""
UBOOT_SUFFIX = "bin"
UBOOT_MAKE_TARGET = ""
SPL_BINARY = "spl/u-boot-spl.bin"

UBOOT_CONFIG ??= "sd"
UBOOT_CONFIG[sd]   = "${UBOOT_CONFIG_NAME},sdcard"

# Set ATF platform name
ATF_PLATFORM = "imx8ulp"

# Set u-boot DTB
UBOOT_DTB_NAME = "${UBOOT_DEVICETREE_DTBNAME}"

# Set imx-mkimage boot target
IMXBOOT_TARGETS = "flash_singleboot_m33"

IMX_BOOT_SOC_TARGET = "iMX8ULP"
IMX_BOOT_SEEK = "32"

SERIAL_CONSOLES = "115200;ttyLP1"

# Add additional firmware
MACHINE_FIRMWARE:append = " firmware-imx-epdc"
MACHINE_FIRMWARE:append:mx8ulp = " sof-imx sof-zephyr"
```

## conf/machine/include/maaxboard-base.inc
```bitbake
# Embest MaaxBoard common settings

MACHINEOVERRIDES =. "mx8:mx8m:mx8mq:"
MACHINEOVERRIDES =. "maaxboardbase:maaxboard:"

require conf/machine/include/imx-base.inc
require conf/machine/include/tune-cortexa53.inc

MACHINE_FEATURES += " pci wifi bluetooth bcm43455"

MACHINE_SOCARCH_FILTER_append_mx8mq = " virtual/libopenvg virtual/libgles1 virtual/libgles2 virtual/egl virtual/mesa virtual/libgl virtual/libg2d"

KERNEL_DEVICETREE = "freescale/maaxboard-dcss-hdmi.dtb"
KERNEL_DEVICETREE += "freescale/maaxboard-dcss-mipi.dtb"
KERNEL_DEVICETREE += "freescale/maaxboard-lcdif-mipi.dtb"
KERNEL_DEVICETREE += "freescale/maaxboard-dual-display.dtb"
KERNEL_DEVICETREE += "freescale/maaxboard-usb0-device.dtb"

WKS_FILE_DEPENDS_append = " uenv"
IMAGE_BOOT_FILES += "uEnv.txt"

UBOOT_CONFIG ??= "sd"
UBOOT_CONFIG[sd] = "maaxboard_defconfig,sdcard"

# Set u-boot DTB
UBOOT_DTB_NAME = "maaxboard.dtb"

# Set imx-mkimage boot target
IMXBOOT_TARGETS = "flash_ddr4_val"

# Used by poky/meta/recipes-bsp/u-boot/u-boot.inc
SPL_BINARY = "spl/u-boot-spl.bin"

# Set DDR FIRMWARE
DDR_FIRMWARE_NAME = "ddr4_imem_1d.bin ddr4_dmem_1d.bin ddr4_imem_2d.bin ddr4_dmem_2d.bin"

# More refer to meta-fsl-bsp-release/imx/meta-bsp/classes/image_types_fsl.bbclass
IMAGE_BOOTLOADER = "imx-boot"
IMX_BOOT_SEEK = "33"
OPTEE_BIN_EXT = "8mq"

# Boot partition size [in KiB] for kernel and other data
# More refer to meta-fsl-bsp-release/imx/meta-bsp/classes/image_types_fsl.bbclass
BOOT_SPACE = "65536"

# Refer to linux-imx/drivers/tty/serial/imx.c
SERIAL_CONSOLES = "115200;ttymxc0"

LOADADDR = ""
UBOOT_SUFFIX = "bin"
UBOOT_MAKE_TARGET = ""

PREFERRED_PROVIDER_virtual/bootloader = "u-boot-imx"
PREFERRED_PROVIDER_u-boot = "u-boot-imx"
PREFERRED_VERSION_u-boot-imx = "2020.04"

# meta-fsl-bsp-release/imx/meta-bsp/conf/machine/include/imx-base.inc
PREFERRED_PROVIDER_virtual/kernel = "linux-imx"
PREFERRED_VERSION_linux-imx = "5.4"
PREFERRED_VERSION_linux-imx-headers = "5.4"

# Use gstreamer 1.14 from meta-freescale
PREFERRED_VERSION_gstreamer1.0 ?= "1.14.imx"
PREFERRED_VERSION_gstreamer1.0-plugins-base ?= "1.14.imx"
PREFERRED_VERSION_gstreamer1.0-plugins-good ?= "1.14.imx"
PREFERRED_VERSION_gstreamer1.0-plugins-bad ?= "1.14.imx"
PREFERRED_VERSION_gstreamer1.0-libav ?= "1.14.0"

# /etc/hostname
hostname_pn-base-files = "maaxboard"
```

## conf/machine/include/maaxboard-mini-base.inc
```bitbake
# Embest MaaxBoard Mini common settings

MACHINEOVERRIDES =. "mx8:mx8m:mx8mm:"
MACHINEOVERRIDES =. "maaxboardbase:maaxboardmini:"

require conf/machine/include/imx-base.inc
require conf/machine/include/tune-cortexa53.inc

MACHINE_FEATURES += " pci wifi bluetooth bcm43455"

KERNEL_DEVICETREE  = "freescale/maaxboard-mini-mipi.dtb"
KERNEL_DEVICETREE += "freescale/maaxboard-mini-lvds.dtb"
KERNEL_DEVICETREE += "freescale/maaxboard-mini-device.dtb"

WKS_FILE_DEPENDS_append = " uenv"
IMAGE_BOOT_FILES += "uEnv.txt"

UBOOT_CONFIG ??= "sd"
UBOOT_CONFIG[sd] = "maaxboard_mini_defconfig,sdcard"

# Set u-boot DTB
UBOOT_DTB_NAME = "maaxboard-mini.dtb"

# Set imx-mkimage boot target
IMXBOOT_TARGETS = "flash_ddr4_evk"

# Used by poky/meta/recipes-bsp/u-boot/u-boot.inc
SPL_BINARY = "spl/u-boot-spl.bin"

# Set DDR FIRMWARE
DDR_FIRMWARE_NAME = "ddr4_imem_1d.bin ddr4_dmem_1d.bin ddr4_imem_2d.bin ddr4_dmem_2d.bin"

# More refer to meta-fsl-bsp-release/imx/meta-bsp/classes/image_types_fsl.bbclass
IMAGE_BOOTLOADER = "imx-boot"
IMX_BOOT_SEEK = "33"

# Boot partition size [in KiB] for kernel and other data
# More refer to meta-fsl-bsp-release/imx/meta-bsp/classes/image_types_fsl.bbclass
BOOT_SPACE = "65536"

# uboot-imx/include/configs/maaxboard_mini.h
# Refer to linux-imx/drivers/tty/serial/imx.c
SERIAL_CONSOLES = "115200;ttymxc0"

UBOOT_SUFFIX = "bin"
UBOOT_MAKE_TARGET = ""

PREFERRED_PROVIDER_virtual/bootloader = "u-boot-imx"
PREFERRED_PROVIDER_u-boot = "u-boot-imx"
PREFERRED_VERSION_u-boot-imx = "2020.04"

# meta-fsl-bsp-release/imx/meta-bsp/conf/machine/include/imx-base.inc
PREFERRED_PROVIDER_virtual/kernel = "linux-imx"
PREFERRED_VERSION_linux-imx = "5.4"
PREFERRED_VERSION_linux-imx-headers = "5.4"

# /etc/hostname
hostname_pn-base-files = "maaxboard-mini"
```

## conf/machine/include/maaxboard-nano-base.inc
```bitbake
# Embest MaaxBoard Mini common settings

MACHINEOVERRIDES =. "mx8:mx8m:mx8mn:"
MACHINEOVERRIDES =. "maaxboardbase:maaxboardnano:"

require conf/machine/include/imx-base.inc
require conf/machine/include/tune-cortexa53.inc

MACHINE_FEATURES += " wifi bluetooth nxp8987"

KERNEL_DEVICETREE  = "freescale/maaxboard-nano-mipi.dtb"

WKS_FILE_DEPENDS_append = " uenv"
IMAGE_BOOT_FILES += "uEnv.txt"


UBOOT_CONFIG ??= "sd"
UBOOT_CONFIG[sd] = "maaxboard_nano_defconfig,sdcard"

# Set u-boot DTB
UBOOT_DTB_NAME = "maaxboard-nano-mipi.dtb"

# Set imx-mkimage boot target
IMXBOOT_TARGETS = "flash_ddr4_evk"

# Used by poky/meta/recipes-bsp/u-boot/u-boot.inc
SPL_BINARY = "spl/u-boot-spl.bin"

# Set DDR FIRMWARE
# Refer to meta-fsl-bsp-release/imx/meta-bsp/recipes-bsp/imx-mkimage/imx-boot_1.0.bb
# meta-fsl-bsp-release/imx/meta-bsp/recipes-bsp/firmware-imx/firmware-imx-8m_8.8.bb
DDR_FIRMWARE_NAME = "ddr4_imem_1d_201810.bin ddr4_dmem_1d_201810.bin ddr4_imem_2d_201810.bin ddr4_dmem_2d_201810.bin"
# DDR_FW_VERSION = "201810"


# More refer to meta-fsl-bsp-release/imx/meta-bsp/classes/image_types_fsl.bbclass
IMAGE_BOOTLOADER = "imx-boot"
IMX_BOOT_SEEK = "32"

# Boot partition size [in KiB] for kernel and other data
# More refer to meta-fsl-bsp-release/imx/meta-bsp/classes/image_types_fsl.bbclass
BOOT_SPACE = "65536"

# uboot-imx/include/configs/maaxboard_mini.h
# Refer to linux-imx/drivers/tty/serial/imx.c
SERIAL_CONSOLES = "115200;ttymxc1"

LOADADDR = ""
UBOOT_SUFFIX = "bin"
UBOOT_MAKE_TARGET = ""

PREFERRED_PROVIDER_virtual/bootloader = "u-boot-imx"
PREFERRED_PROVIDER_u-boot = "u-boot-imx"
PREFERRED_VERSION_u-boot-imx = "2020.04"

# meta-fsl-bsp-release/imx/meta-bsp/conf/machine/include/imx-base.inc
PREFERRED_PROVIDER_virtual/kernel = "linux-imx"
PREFERRED_VERSION_linux-imx = "5.4"
PREFERRED_VERSION_linux-imx-headers = "5.4"
```

## conf/machine/maaxboard-8ulp.conf
```bitbake
#@TYPE: Machine
#@NAME: Avnet MaaxBoard 8ULP
#@SOC: i.MX8ULP
#@DESCRIPTION: Machine configuration for Avnet MaaxBoard 8ULP with LPDDR4
#@MAINTAINER: Wenxue Guo <wenxue.guo@avnet.com>
#@REFERENCE: meta-imx/meta-bsp/conf/machine/imx8ulpevk.conf

MACHINEOVERRIDES =. "mx8:mx8ulp:"
MACHINEOVERRIDES =. "maaxboardbase:maaxboard8ulp:"

require conf/machine/include/imx-base.inc
require conf/machine/include/arm/armv8a/tune-cortexa35.inc

DEFAULTTUNE:maaxboard8ulp?= "cortexa35-crypto"
MACHINEOVERRIDES_EXTENDER:mx8ulp = "imxdrm:imxgpu:imxgpu2d:imxgpu3d"
MACHINEOVERRIDES_EXTENDER_FILTER_OUT_use-mainline-bsp += " mx8ulp "
MACHINE_SOCARCH_SUFFIX = "-mx8ulp"
MACHINE_GSTREAMER_1_0_PLUGIN ?= "imx-gst1.0-plugin"
IMX_DEFAULT_KERNEL = "linux-imx"
IMX_DEFAULT_BSP = "nxp"

MACHINE_FEATURES += " wifi bluetooth"

# Our MaaXBoard-8ULP board using A0.1 version now
SECO_FIRMWARE_NAME = "mx8ulpa0-ahab-container.img"
UPOWER_FIRMWARE_NAME = "upower_a0.bin"

# Set linux DTB
KERNEL_DEVICETREE = "freescale/maaxboard-8ulp.dtb"

# Set U-boot config
UBOOT_DTB_NAME = "maaxboard-8ulp.dtb"
LOADADDR = ""
UBOOT_SUFFIX = "bin"
UBOOT_MAKE_TARGET = ""
SPL_BINARY = "spl/u-boot-spl.bin"
UBOOT_CONFIG ??= "sd"
UBOOT_CONFIG[sd]   = "maaxboard-8ulp_defconfig,sdcard"
SERIAL_CONSOLES = "115200;ttyLP1"

# Set ATF platform name
ATF_PLATFORM = "imx8ulp"

# Set imx-mkimage boot target
IMXBOOT_TARGETS = "flash_singleboot_m33"
IMX_BOOT_SOC_TARGET = "iMX8ULP"
IMX_BOOT_SEEK = "32"

# Add additional firmware
SOC_DEFAULT_IMAGE_FSTYPES:append = " wic"

# Remove unused QT example program
#CORE_IMAGE_EXTRA_INSTALL:remove = " qtbase-ptest qtbase-examples"

# Add uEnv.txt file to FAT partition
WKS_FILE_DEPENDS:append = " uenv"
IMAGE_BOOT_FILES += "uEnv.txt"
IMAGE_BOOT_FILES += "readme.txt"
IMAGE_BOOT_FILES += "overlays/*;overlays/"

# /etc/hostname
hostname:pn-base-files = "maaxboard8ulp"
```

## conf/machine/maaxboard-ddr4-2g-sdcard.conf
```bitbake
#@TYPE: Machine
#@NAME: Embest MaaxBoard
#@SOC: i.MX8MQ
#@DESCRIPTION: Machine configuration for Embest MaaxBoard, DDR4, SDCard
#@MAINTAINER: Paul Niu <ahnniu@gmail.com>

include conf/machine/include/maaxboard-base.inc
```

## conf/machine/maaxboard-mini-ddr4-2g-sdcard.conf
```bitbake
#@TYPE: Machine
#@NAME: Embest MaaxBoard
#@SOC: i.MX8MM
#@DESCRIPTION: Machine configuration for Embest MaaxBoard Mini, DDR4, SDCard
#@MAINTAINER: Paul Niu <ahnniu@gmail.com>

include conf/machine/include/maaxboard-mini-base.inc
```

## conf/machine/maaxboard-mini.conf
```bitbake
#@TYPE: Machine
#@NAME: Avnet MaaxBoard-Mini
#@SOC: i.MX8M Mini
#@DESCRIPTION: Machine configuration for Avnet MaaxBoard-Mini 2G, DDR4, SDCard
#@MAINTAINER: Wenxue Guo <wenxue.guo@avnet.com>
#@REFERENCE: meta-freescale/conf/machine/imx8mm-ddr4-evk.conf

MACHINEOVERRIDES =. "mx8:mx8m:mx8mm:"
MACHINEOVERRIDES =. "maaxboardbase:maaxboardmini:"

require conf/machine/include/imx-base.inc
require conf/machine/include/arm/armv8a/tune-cortexa53.inc

MACHINE_FEATURES += " wifi bluetooth bcm43455"

# Set DDR FIRMWARE, Refer to: 
# meta-imx/meta-bsp/recipes-bsp/imx-mkimage/imx-boot_1.3.bb
# meta-imx/meta-bsp/recipes-bsp/firmware-imx/firmware-imx-8_8.20.bb
DDR_FIRMWARE_NAME = " ddr4_imem_1d.bin ddr4_dmem_1d.bin ddr4_imem_2d.bin ddr4_dmem_2d.bin "

# Set linux DTB
KERNEL_DEVICETREE = "freescale/maaxboard-mini.dtb"
KERNEL_IMAGETYPE = "Image"

# Set u-boot DTB 
UBOOT_DTB_NAME = "maaxboard-mini.dtb"
LOADADDR = ""
UBOOT_SUFFIX = "bin"
UBOOT_MAKE_TARGET = ""
SPL_BINARY = "spl/u-boot-spl.bin"
UBOOT_CONFIG ??= "sd"
UBOOT_CONFIG[sd] = "maaxboard-mini_defconfig,sdcard"
SERIAL_CONSOLES = "115200;ttymxc0"

# Set ATF platform name
ATF_PLATFORM = "imx8mm"

# Set imx-mkimage boot target
IMXBOOT_TARGETS = "flash_ddr4_evk"
IMX_BOOT_SOC_TARGET = "iMX8MM"
IMX_BOOT_SEEK = "33"
OPTEE_BIN_EXT = "8mm"

SOC_DEFAULT_IMAGE_FSTYPES:append = " wic"

# Remove unused QT example program
#CORE_IMAGE_EXTRA_INSTALL:remove += " qtbase-ptest qtbase-examples"

# Boot partition size [in KiB] for kernel and other data
# More refer to: meta-freescale/classes/image_types_fsl.bbclass
BOOT_SPACE = "65536"

# Add uEnv.txt file to FAT partition
WKS_FILE_DEPENDS:append = " uenv"
IMAGE_BOOT_FILES += "uEnv.txt"
IMAGE_BOOT_FILES += "readme.txt"
IMAGE_BOOT_FILES += "overlays/*;overlays/"

# /etc/hostname
hostname:pn-base-files = "maaxboardmini"
```
